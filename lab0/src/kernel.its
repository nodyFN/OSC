## lab0/src/kernel.its
```
/dts-v1/;

/ {
    description = "Minimal FIT Image";
    images {
        kernel {
            data = /incbin/("kernel.bin");
            type = "kernel";
            arch = "riscv";
            os = "linux";
            compression = "none";
            load = <0x0 0x40200000>;
            entry = <0x0 0x40200000>;
        };
        fdt {
            data = /incbin/("jh7110-starfive-visionfive-2-v1.3b.dtb");
            type = "flat_dt";
            arch = "riscv";
            compression = "none";
        };
    };
    configurations {
        default = "conf";
        conf {
            kernel = "kernel";
            fdt = "fdt";
        };
    };
};
```
